## main/Kconfig.projbuild
```kconfig
menu "Configuração do Wifi Configuration"

    config ESP_WIFI_SSID
        string "WiFi SSID"
        default "ssid"
        help
            Nome da rede Wifi.

    config ESP_WIFI_PASSWORD
        string "Senha do Wifi"
        default "minha_senha"
        help
            Senha do WiFi (WPA or WPA2).

    config ESP_MAXIMUM_RETRY
        int "Número máximo de tentativas de conexão"
        default 5
        help
            Configure o valor máximo de tentativas de conexão.
endmenu

menu "Configuração das chaves HTTP"

    config IP_STACK_KEY
        string "chave do ipstack"
        default "minha_chave"
        help
            Chave do ipstack.

    config OPEN_WEATHER_MAP_KEY
        string "chave do openweathermap"
        default "minha_chave"
        help
            Chave do OpenWeatherMap.

endmenu
```
